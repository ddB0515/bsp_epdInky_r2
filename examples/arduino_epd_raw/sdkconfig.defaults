## examples/idf_epd_ha_firmware/main/Kconfig.projbuild
```kconfig
menu "Home Assistant e-paper firmware"

choice HA_WAIT_MODE
    prompt "What the device does between cycles"
    default HA_WAIT_DEEP_SLEEP
    help
      Two builds of the same firmware, so this board's sleep current can be
      measured by flashing one and then the other. See the help on each
      option - they are not equivalent, and deep sleep costs the button.

config HA_WAIT_DEEP_SLEEP
    bool "Deep sleep, timer wake only"
    help
      esp_deep_sleep_start() with a timer wake-up. Wi-Fi and MQTT are torn
      down and the TPS65185 is put to sleep first. Each cycle is then a fresh
      boot, so expect a couple of seconds of start-up before the next
      publish/fetch/display round.

      KNOWN BAD ON ESP32-P4 CHIP REVISION 1.0/1.3: these silicon revisions
      have documented deep-sleep issues, fixed from revision v3.0 onward. If
      that's the chip on your board, use "Idle, button works" below instead.
      Check the chip revision with `idf.py -p PORT monitor` at boot.

      THE BUTTON DOES NOT WORK IN THIS MODE. The P4 has 16 RTC-capable GPIOs
      (0-15) and the button is on GPIO35, so it cannot drive an ext0/ext1
      wake. Nothing polls it while the CPU is off; a press does nothing until
      the timer fires. Press RESET for an immediate refresh instead.

config HA_WAIT_IDLE
    bool "Idle, button works"
    help
      vTaskDelay() in 100 ms steps with the radio associated and the CPU
      clocked, polling the button so a press starts a cycle immediately -
      the "refresh now" gesture. Not a power-saving mode; use it on a bench
      supply, or while the button matters more than the battery.

endchoice

choice HA_PANEL
    prompt "Which e-paper panel is physically connected"
    default HA_PANEL_ED103TC2
    help
      Sets both the physical panel driver this firmware brings up and the
      resolution it reports (HA_DISPLAY_WIDTH/HEIGHT in ha_config.h) - this
      firmware has no fixed external server to keep a resolution promise to,
      so unlike the trmnl-firmware example the two always match. Point your
      dashboard-render service at whichever size you pick here.

config HA_PANEL_ED103TC2
    bool "ED103TC2 - 10.3\", 1872x1404"

config HA_PANEL_ED133UT2
    bool "ED133UT2 - 13.3\", 2200x1650"

endchoice

config HA_MQTT_DEFAULT_PORT
    int "Default MQTT broker port"
    default 1883
    help
      Pre-filled into the captive portal's MQTT port field; the user can
      still type a different one (e.g. 8883 for MQTTS). Only a build-time
      default - the value actually used is whatever was submitted through
      the portal and stored in NVS.

config HA_DEFAULT_REFRESH_INTERVAL_S
    int "Default refresh interval (seconds)"
    default 900
    range 60 86400
    help
      Pre-filled into the captive portal's refresh-interval field, and the
      fallback used if NVS somehow holds nothing plausible. 900 s (15
      minutes) matches the TRMNL example's default cadence.

config HA_MQTT_COMMAND_WINDOW_S
    int "How long to listen for a refresh-button press each cycle (seconds)"
    default 3
    range 1 30
    help
      After publishing discovery configs and state, the device subscribes to
      its refresh-button command topic for this many seconds to catch a
      pending press, then disconnects. Keeping this short matters more than
      it looks: every second here is a second of Wi-Fi and MQTT held open
      once a cycle, whether or not anyone ever presses the button in Home
      Assistant.

endmenu
```

## examples/idf_ha_firmware/main/Kconfig.projbuild
```kconfig
menu "Home Assistant TFT dashboard firmware"

choice HA_PANEL
    prompt "Which display panel is physically connected"
    default HA_PANEL_D320C2403V1_JD9168
    help
        The panel abstraction (main/ha_panel.h) is a hard requirement of this
        firmware so more panels can be added later without touching anything
        else - main.c, ha_lvgl.c and ha_dashboard.c only ever call the
        ha_panel_*()/ha_touch_*() interface, never a driver directly. Only one
        physical panel is supported today.

    config HA_PANEL_D320C2403V1_JD9168
        bool "D320C2403V1-MIPI, 1024x768, JD9168 driver, GT967 touch"
        help
            The panel examples/idf_dsi_camera_preview already proved on this
            board: 3.2", MIPI-DSI, RGB888, 2 data lanes, plugged into FPC1
            through an adapter board carrying its own TCA6408 at 0x20.
endchoice

config HA_DISPLAY_BRIGHTNESS_PERCENT
    int "Backlight brightness while awake (percent)"
    default 80
    range 5 100
    help
        Passed to ha_panel_set_backlight() once the dashboard is built. The
        backlight is the SGM37604A on the display module, driven over I2C -
        there is no PWM/GPIO brightness control on this board.

config HA_DISPLAY_DIM_PERCENT
    int "Backlight brightness after the idle timeout (percent)"
    default 15
    range 0 100
    help
        A wall panel that is always showing something bright, always, is
        both needless glare and needless backlight wear. Any touch restores
        HA_DISPLAY_BRIGHTNESS_PERCENT immediately, skipping this dimmed
        stage entirely - see HA_DISPLAY_OFF_DELAY_S for what happens if the
        panel stays untouched even longer than this.

config HA_DISPLAY_IDLE_TIMEOUT_S
    int "Seconds of no touch before dimming"
    default 120
    range 10 3600

config HA_DISPLAY_OFF_DELAY_S
    int "Further seconds of no touch (after dimming) before the backlight turns off"
    default 60
    range 5 3600
    help
        Measured from when the panel dims (HA_DISPLAY_IDLE_TIMEOUT_S), not
        from the last touch - so the total time from last touch to backlight
        off is HA_DISPLAY_IDLE_TIMEOUT_S + this value. Any touch restores
        full brightness immediately, direct from off - there is no need to
        "wake" it back through the dimmed stage first.

config HA_WS_DEFAULT_PORT
    int "Default Home Assistant WebSocket port"
    default 8123
    range 1 65535
    help
        Pre-fills the stage-2 config page's port field the first time it is
        shown. The actual value used is always whatever ends up in NVS.

config HA_WS_RECONNECT_MIN_MS
    int "Minimum reconnect backoff (ms)"
    default 1000
    range 200 60000

config HA_WS_RECONNECT_MAX_MS
    int "Maximum reconnect backoff (ms)"
    default 30000
    range 1000 300000
    help
        The Home Assistant WebSocket client (main/ha_ws.c) reconnects
        indefinitely on any disconnect - HA restarts routinely, e.g. after an
        update - doubling the backoff from the minimum up to this cap, with
        jitter, rather than spinning or waiting out one fixed interval.

endmenu
```

## examples/trmnl-firmware/main/Kconfig.projbuild
```kconfig
menu "TRMNL firmware"

choice TRMNL_WAIT_MODE
    prompt "What the device does between cycles"
    default TRMNL_WAIT_DEEP_SLEEP
    help
      Two builds of the same firmware, so this board's sleep current can be
      measured by flashing one and then the other.

      They are not equivalent: deep sleep costs the button. See the help on
      each option.

config TRMNL_WAIT_DEEP_SLEEP
    bool "Deep sleep, timer wake only"
    help
      esp_deep_sleep_start() with a timer wake-up, as upstream does. The SD
      card is unmounted and unpowered, Wi-Fi is torn down and the TPS65185 is
      put to sleep first. Each cycle is then a fresh boot, so expect about
      two seconds of start-up before the request goes out.

      KNOWN BAD ON ESP32-P4 CHIP REVISION 1.0/1.3: these silicon revisions
      have documented deep-sleep issues, fixed from revision v3.0 onward. If
      that's the chip on your board, use "Idle, button works" below instead -
      this is a hardware erratum to wait out on a fixed-revision board, not
      something this firmware can fix around. Check the chip revision with
      `idf.py -p PORT monitor` at boot, or `esptool.py chip_id`.

      THE BUTTON DOES NOT WORK IN THIS MODE. The P4 has 16 RTC-capable GPIOs
      (0-15) and the button is on GPIO35, so it cannot drive an ext0/ext1
      wake. Nothing polls it while the CPU is off; a press does nothing until
      the timer fires. Press RESET for an immediate refresh instead.

      Cross-cycle state (retry counters, the "needs a clean" flag, the last
      wake time) lives in RTC fast memory, which survives the sleep. The
      refresh interval and the device credentials are in NVS and survive
      anything.

config TRMNL_WAIT_IDLE
    bool "Idle, button works"
    help
      vTaskDelay() in 100 ms steps with the radio associated and the CPU
      clocked, polling the button so a press starts a cycle immediately.

      This is not a power-saving mode - it is the reference to measure deep
      sleep against, and the mode to use on a bench supply when the button
      matters more than the battery.

endchoice

choice TRMNL_PANEL
    prompt "Which e-paper panel is physically connected"
    default TRMNL_PANEL_ED103TC2
    help
      trmnl.app only renders content for panel resolutions it knows about,
      reported via the Model/Width/Height headers - see TRMNL_DISPLAY_WIDTH/
      HEIGHT in trmnl_config.h, which do NOT change with this choice. Picking
      a panel the server doesn't support here changes what this firmware
      does with what arrives, not what the server sends: the image is still
      decoded at the reported resolution, then scaled to fit whatever panel
      is actually connected via the same epd_fb_blit_fit_rot()/
      epd_fb_blit_1bpp_fit() path that already handles any size mismatch
      (trmnl_image.c, trmnl_bmp_render()) - there is no separate "scaling
      mode" to turn on, this just puts a differently-sized framebuffer in
      front of it.

config TRMNL_PANEL_ED103TC2
    bool "ED103TC2 - 10.3\", 1872x1404 (trmnl.app's own panel)"
    help
      What P0.0 and P1.2 verified against. Native resolution matches exactly
      what the server renders, so the fit path never actually triggers on
      real server content - only on locally-sized things like a status
      screen, which is already sized to the framebuffer either way.

config TRMNL_PANEL_ED133UT2
    bool "ED133UT2 - 13.3\", 2200x1650 (bench test - trmnl.app doesn't render for this size)"
    help
      Every server-sent frame is smaller than this panel in both dimensions
      (1872x1404 into 2200x1650), so every real cycle takes the upscale path:
      letterboxed, aspect preserved, pixel-repeat rather than interpolated
      (see epd_fb_blit_fit_rot()'s own doc comment on upscale quality).
      Watch the log for "fitting" - trmnl_image.c logs it whenever a decode
      doesn't match the framebuffer 1:1.

endchoice

config TRMNL_LOG_TEST_ON_BOOT
    bool "Send a test /api/log entry every cycle (debug)"
    default n
    help
      submit_log() in main.c only fires from a real failure
      (report_failure()'s call sites), which is awkward to trigger on demand
      without either breaking a working device or waiting for the real
      server to misbehave. This sends one harmless test entry to the real
      /api/log endpoint right after Wi-Fi and registration succeed each
      cycle, so the whole path - serialization, headers, POST, the server's
      actual response - can be checked against a real account without
      engineering a fake outage.

      Off by default and meant to be turned back off once you've confirmed
      it: this is a debug aid, not a feature, and it POSTs to the real
      server every single cycle for as long as it's enabled.

endmenu
```
